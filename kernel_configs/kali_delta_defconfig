## kernel_configs/kali_delta_defconfig
```kconfig
# additional kernel configs for Kali
CONFIG_MEMCG_SWAP=y
CONFIG_CFS_BANDWIDTH=y
CONFIG_RT_GROUP_SCHED=y
CONFIG_CGROUP_PIDS=y
CONFIG_CGROUP_PERF=y
CONFIG_NET_L3_MASTER_DEV=y
CONFIG_CGROUP_NET_PRIO=y
CONFIG_IPVLAN=m
CONFIG_ATH10K=m
CONFIG_WCN36XX=m
CONFIG_RTL8XXXU_UNTESTED=y
CONFIG_RTL8812AU=m
CONFIG_RTL8814AU=m
CONFIG_RTL8188EU=m
CONFIG_NETWORK_SECMARK=y
CONFIG_CGROUP_BPF=y
CONFIG_4DPI_FT5X06=m
```
